/*
 * Copyright (c) 2020 The ZMK Contributors
 * Copyright (c) 2025 Innaworks Development Limited, trading as MoErgo
 *
 * SPDX-License-Identifier: MIT
 */


/* THIS FILE WAS GENERATED BY GLOVE80 LAYOUT EDITOR
 *
 * This file was generated automatically. You may or may not want to
 * edit it directly.
 */

#include <behaviors.dtsi>
/* Include all behavior includes needed */
#include <dt-bindings/zmk/outputs.h>
#include <dt-bindings/zmk/keys.h>
#include <dt-bindings/zmk/bt.h>
#include <dt-bindings/zmk/rgb.h>

/* On demand includes */
#include <dt-bindings/zmk/input_transform.h>
#include <dt-bindings/zmk/pointing.h>
#include <input/processors.dtsi>


/* Helper Macros, based on https://github.com/urob/zmk-helpers/ */

#pragma once

#define ZMK_HELPER_STRINGIFY(x) #x

// Preprocessor mechanism to overload macros, cf. https://stackoverflow.com/a/27051616/6114651
#define VARGS_(_10, _9, _8, _7, _6, _5, _4, _3, _2, _1, N, ...) N
#define VARGS(...) VARGS_(__VA_ARGS__, 10, 9, 8, 7, 6, 5, 4, 3, 2, 1, 0)
#define CONCAT_(a, b) a##b
#define CONCAT(a, b) CONCAT_(a, b)

#define ZMK_BEHAVIOR_CORE_tap_dance  \
    compatible = "zmk,behavior-tap-dance"; \
    #binding-cells = <0>

#define ZMK_BEHAVIOR(name, type, ...) \
    name: name { \
        ZMK_BEHAVIOR_CORE_ ## type; \
        __VA_ARGS__ \
    };

#define ZMK_TAP_DANCE(name, ...) \
    ZMK_BEHAVIOR(name, tap_dance, __VA_ARGS__)

#define ZMK_TD_LAYER(name, layer) \
    ZMK_TAP_DANCE(name, \
        tapping-term-ms = <200>; \
        bindings = <&mo layer>, <&to layer>; \
)

/* Environment and metadata defines */
#define KB_TYPE_GLOVE_80 1
#define KB_TYPE_GO_60    2

#define KB_TYPE          KB_TYPE_GLOVE_80
#define EDITOR_HOST_OS   'W'

/* Automatically generated layer name defines */
#define LAYER_Base 0
#define LAYER_Lower 1
#define LAYER_Magic 2
#define LAYER_Programming 3
#define LAYER_Numbers 4
#define LAYER_Navigation 5
#define LAYER_Mouse 6
#define LAYER_MouseSlow 7
#define LAYER_MouseRegular 8
#define LAYER_MouseFast 9
#define LAYER_Factory 10

/* To deal with the situation where there is no Lower layer, to keep &lower happy */
#ifndef LAYER_Lower
#define LAYER_Lower 0
#endif

/* Custom Device-tree */


/* Input Listeners */
&mmv_input_listener {
    MouseSlow {
        layers = <LAYER_MouseSlow>;
        input-processors = <&zip_xy_scaler 1 9>;
    };
    MouseRegular {
        layers = <LAYER_MouseRegular>;
        input-processors = <&zip_xy_scaler 3 1>;
    };
    MouseFast {
        layers = <LAYER_MouseFast>;
        input-processors = <&zip_xy_scaler 12 1>;
    };
};

&msc_input_listener {
    MouseSlow {
        layers = <LAYER_MouseSlow>;
        input-processors = <&zip_scroll_scaler 1 9>;
    };
    MouseRegular {
        layers = <LAYER_MouseRegular>;
        input-processors = <&zip_scroll_scaler 3 1>;
    };
    MouseFast {
        layers = <LAYER_MouseFast>;
        input-processors = <&zip_scroll_scaler 12 1>;
    };
};


/* System behavior and Macros */
/ {
    behaviors {
        ZMK_TD_LAYER(lower, LAYER_Lower)
    };
};

/ {
    macros {
        rgb_ug_status_macro: rgb_ug_status_macro {
            label = "RGB_UG_STATUS";
            compatible = "zmk,behavior-macro";
            #binding-cells = <0>;
            bindings
                = <&rgb_ug RGB_STATUS>;
        };
    };
};


/ {
#ifdef BT_DISC_CMD
    behaviors {
        bt_0: bt_0 {
            compatible = "zmk,behavior-tap-dance";
            label = "BT_0";
            #binding-cells = <0>;
            tapping-term-ms = <200>;
            bindings = <&bt_select_0>, <&bt BT_DISC 0>;
        };
        bt_1: bt_1 {
            compatible = "zmk,behavior-tap-dance";
            label = "BT_1";
            #binding-cells = <0>;
            tapping-term-ms = <200>;
            bindings = <&bt_select_1>, <&bt BT_DISC 1>;
        };
        bt_2: bt_2 {
            compatible = "zmk,behavior-tap-dance";
            label = "BT_2";
            #binding-cells = <0>;
            tapping-term-ms = <200>;
            bindings = <&bt_select_2>, <&bt BT_DISC 2>;
        };
        bt_3: bt_3 {
            compatible = "zmk,behavior-tap-dance";
            label = "BT_3";
            #binding-cells = <0>;
            tapping-term-ms = <200>;
            bindings = <&bt_select_3>, <&bt BT_DISC 3>;
        };
    };
    macros {
        bt_select_0: bt_select_0 {
            label = "BT_SELECT_0";
            compatible = "zmk,behavior-macro";
            #binding-cells = <0>;
            bindings
                = <&out OUT_BLE>,
                  <&bt BT_SEL 0>;
        };
        bt_select_1: bt_select_1 {
            label = "BT_SELECT_1";
            compatible = "zmk,behavior-macro";
            #binding-cells = <0>;
            bindings
                = <&out OUT_BLE>,
                  <&bt BT_SEL 1>;
        };
        bt_select_2: bt_select_2 {
            label = "BT_SELECT_2";
            compatible = "zmk,behavior-macro";
            #binding-cells = <0>;
            bindings
                = <&out OUT_BLE>,
                  <&bt BT_SEL 2>;
        };
        bt_select_3: bt_select_3 {
            label = "BT_SELECT_3";
            compatible = "zmk,behavior-macro";
            #binding-cells = <0>;
            bindings
                = <&out OUT_BLE>,
                  <&bt BT_SEL 3>;
        };
    };
#else
    macros {
        bt_0: bt_0 {
            label = "BT_0";
            compatible = "zmk,behavior-macro";
            #binding-cells = <0>;
            bindings
                = <&out OUT_BLE>,
                  <&bt BT_SEL 0>;
        };
        bt_1: bt_1 {
            label = "BT_1";
            compatible = "zmk,behavior-macro";
            #binding-cells = <0>;
            bindings
                = <&out OUT_BLE>,
                  <&bt BT_SEL 1>;
        };
        bt_2: bt_2 {
            label = "BT_2";
            compatible = "zmk,behavior-macro";
            #binding-cells = <0>;
            bindings
                = <&out OUT_BLE>,
                  <&bt BT_SEL 2>;
        };
        bt_3: bt_3 {
            label = "BT_3";
            compatible = "zmk,behavior-macro";
            #binding-cells = <0>;
            bindings
                = <&out OUT_BLE>,
                  <&bt BT_SEL 3>;
        };
    };
#endif
};

/ {
    behaviors {
        magic: magic {
            compatible = "zmk,behavior-hold-tap";
            label = "MAGIC_HOLD_TAP";
            #binding-cells = <2>;
            flavor = "tap-preferred";
            tapping-term-ms = <200>;
            bindings = <&mo>, <&rgb_ug_status_macro>;
        };
    };
};


/* Key positions */

#define POS_LH_C6R1 0
#define POS_LH_C5R1 1
#define POS_LH_C4R1 2
#define POS_LH_C3R1 3
#define POS_LH_C2R1 4
#define POS_RH_C2R1 5
#define POS_RH_C3R1 6
#define POS_RH_C4R1 7
#define POS_RH_C5R1 8
#define POS_RH_C6R1 9
#define POS_LH_C6R2 10
#define POS_LH_C5R2 11
#define POS_LH_C4R2 12
#define POS_LH_C3R2 13
#define POS_LH_C2R2 14
#define POS_LH_C1R2 15
#define POS_RH_C1R2 16
#define POS_RH_C2R2 17
#define POS_RH_C3R2 18
#define POS_RH_C4R2 19
#define POS_RH_C5R2 20
#define POS_RH_C6R2 21
#define POS_LH_C6R3 22
#define POS_LH_C5R3 23
#define POS_LH_C4R3 24
#define POS_LH_C3R3 25
#define POS_LH_C2R3 26
#define POS_LH_C1R3 27
#define POS_RH_C1R3 28
#define POS_RH_C2R3 29
#define POS_RH_C3R3 30
#define POS_RH_C4R3 31
#define POS_RH_C5R3 32
#define POS_RH_C6R3 33
#define POS_LH_C6R4 34
#define POS_LH_C5R4 35
#define POS_LH_C4R4 36
#define POS_LH_C3R4 37
#define POS_LH_C2R4 38
#define POS_LH_C1R4 39
#define POS_RH_C1R4 40
#define POS_RH_C2R4 41
#define POS_RH_C3R4 42
#define POS_RH_C4R4 43
#define POS_RH_C5R4 44
#define POS_RH_C6R4 45
#define POS_LH_C6R5 46
#define POS_LH_C5R5 47
#define POS_LH_C4R5 48
#define POS_LH_C3R5 49
#define POS_LH_C2R5 50
#define POS_LH_C1R5 51
#define POS_LH_T1 52
#define POS_LH_T2 53
#define POS_LH_T3 54
#define POS_RH_T3 55
#define POS_RH_T2 56
#define POS_RH_T1 57
#define POS_RH_C1R5 58
#define POS_RH_C2R5 59
#define POS_RH_C3R5 60
#define POS_RH_C4R5 61
#define POS_RH_C5R5 62
#define POS_RH_C6R5 63
#define POS_LH_C6R6 64
#define POS_LH_C5R6 65
#define POS_LH_C4R6 66
#define POS_LH_C3R6 67
#define POS_LH_C2R6 68
#define POS_LH_T4 69
#define POS_LH_T5 70
#define POS_LH_T6 71
#define POS_RH_T6 72
#define POS_RH_T5 73
#define POS_RH_T4 74
#define POS_RH_C2R6 75
#define POS_RH_C3R6 76
#define POS_RH_C4R6 77
#define POS_RH_C5R6 78
#define POS_RH_C6R6 79


/* Custom Defined Behaviors */
/ {
#undef ZMK_POINTING_DEFAULT_MOVE_VAL
#define ZMK_POINTING_DEFAULT_MOVE_VAL 2500
#define ZMK_POINTING_DEFAULT_SCRL_VAL 25
};

/* Per-key RGB lighting — NOT AVAILABLE in standard MoErgo ZMK fork (requires rgb_colors.h) */
/* Kept as reference for future use if MoErgo adds support */
#if __has_include(<dt-bindings/zmk/rgb_colors.h>)

#define RED_RGB 0xFF0000
#define ORN_RGB 0xFF8000
#define YLW_RGB 0xFFFF00
#define GRN_RGB 0x00FF00
#define CYN_RGB 0x00FFFF
#define AZU_RGB 0x99F5FF
#define BLU_RGB 0x0000FF
#define PUR_RGB 0x7A00FF
#define MAJ_RGB 0xFF00FF
#define PNK_RGB 0xFF80BF
#define WHT_RGB 0xFFFFFF
#define BLK_RGB 0x000000
#define COR_RGB 0xFF7C4D
#define GOL_RGB 0xFFD900

#define RED &ug RED_RGB
#define ORN &ug ORN_RGB
#define YLW &ug YLW_RGB
#define GRN &ug GRN_RGB
#define CYN &ug CYN_RGB
#define AZU &ug AZU_RGB
#define BLU &ug BLU_RGB
#define PUR &ug PUR_RGB
#define MAJ &ug MAJ_RGB
#define PNK &ug PNK_RGB
#define WHT &ug WHT_RGB
#define ___ &ug BLK_RGB
#define COR &ug COR_RGB
#define GOL &ug GOL_RGB

#define BCL &ug_cl BLK_RGB YLW_RGB

/ {
  underglow-layer {
    compatible = "zmk,underglow-layer";

    /* Base: iluminar CAPS y Space cuando Magic esta activo (via Magic layer) */
    /* CapsLock indicator en tecla CAPS */
    #ifdef LAYER_Base
    Base {
      bindings = <
        ___ ___ BCL ___ ___                                             ___ ___ ___ ___ ___
        ___ ___ ___ ___ ___ ___                                     ___ ___ ___ ___ ___ ___
        ___ ___ ___ ___ ___ ___                                     ___ ___ ___ ___ ___ ___
        ___ ___ ___ ___ ___ ___                                     ___ ___ ___ ___ ___ ___
        ___ ___ ___ ___ ___ ___     ___ ___ BCL     ___ ___ ___     ___ ___ ___ ___ ___ ___
        ___ ___ ___ ___ ___         ___ ___ ___     ___ ___ ___         ___ ___ ___ ___ ___
      >;
      layer-id = <LAYER_Base>;
      fade-delay = <15>;
    };
    #endif

    /* Magic: iluminar CAPS(Numbers) y Space(Mouse) como accesos a capas */
    #ifdef LAYER_Magic
    Magic {
      bindings = <
        RED ___ ___ ___ ___                                             ___ ___ ___ ___ RED
        ___ ___ GRN GRN ___ ___                                     ___ ___ ___ ___ ___ ___
        ___ PNK PNK PNK PNK PNK                                     ___ ___ ___ ___ ___ ___
        RED PNK PNK PNK PNK PNK                                     ___ ___ ___ ___ ___ RED
        RED ___ ___ ___ ___ ___     BLU BLU YLW     ___ ___ ___     ___ ___ ___ ___ ___ RED
        ___ ___ ___ ___ ___         BLU BLU BLU     ___ ___ MAJ         ___ ___ ___ ___ ORN
      >;
      layer-id = <LAYER_Magic>;
      fade-delay = <5>;
    };
    #endif

    /* Programming: simbolos en naranja */
    #ifdef LAYER_Programming
    Programming {
      bindings = <
        ___ ___ ___ ___ ___                                             ___ ___ ___ ___ ___
        ___ ___ ___ ___ ___ ___                                     ___ ___ ___ ___ ___ ___
        ___ ___ ORN ___ ORN ___                                     ORN ORN ORN ORN ___ ___
        ___ YLW ORN ORN ORN ___                                     ORN ORN ORN ORN ORN ___
        PNK ___ ___ ___ ORN ___     ___ ___ GRN     ___ ___ ___     ORN ORN ORN ORN ORN ___
        PNK PNK ___ ___ ___         ___ ___ ___     ___ ___ ___         ORN ORN ORN ___ ___
      >;
      layer-id = <LAYER_Programming>;
      fade-delay = <5>;
    };
    #endif

    /* Numbers: numeros en cyan, F-keys en cyan, operadores en naranja, RShift iluminado */
    #ifdef LAYER_Numbers
    Numbers {
      bindings = <
        ___ ___ ___ ___ ___                                             ___ ___ ___ ___ ___
        ___ ___ CYN CYN CYN ___                                     ___ ___ ORN ORN ORN ___
        ___ ___ CYN CYN CYN ___                                     ___ CYN CYN CYN ORN ___
        YLW YLW CYN CYN CYN ___                                     ___ CYN CYN CYN ORN ___
        YLW YLW CYN CYN CYN ___     ___ ___ GRN     ___ ___ GOL     ___ CYN CYN CYN ___ ___
        ___ ___ ___ ___ ___         ___ ___ ___     ___ ___ ___         CYN ORN ___ ___ ___
      >;
      layer-id = <LAYER_Numbers>;
      fade-delay = <5>;
    };
    #endif

    /* Navigation: flechas azul, media rosa, ctrl+shift en violeta */
    #ifdef LAYER_Navigation
    Navigation {
      bindings = <
        ___ ___ ___ ___ ___                                             ___ ___ ___ ___ ___
        ___ ___ ___ ___ ___ ___                                     ___ ___ ___ ___ ___ ___
        ___ ___ PNK PNK PNK ___                                     ___ AZU BLU AZU ___ ___
        ___ ___ PNK PNK PNK ___                                     ___ BLU BLU BLU ___ ___
        ___ ___ ___ ___ ___ ___     PUR ___ ___     ___ ___ ___     ___ GRN ___ GRN ___ ___
        ___ ___ ___ ___ ___         ___ ___ ___     ___ ___ ___         ___ ___ ___ ___ ___
      >;
      layer-id = <LAYER_Navigation>;
      fade-delay = <5>;
    };
    #endif

    /* Mouse: cursor azul, scroll cyan, clicks amarillo, velocidad naranja */
    #ifdef LAYER_Mouse
    Mouse {
      bindings = <
        ___ ___ ___ ___ ___                                             ___ ___ ___ ___ ___
        ___ ___ ___ ___ ___ ___                                     ___ ___ ___ ___ ___ ___
        ___ ___ YLW CYN YLW ___                                     ___ AZU BLU AZU ___ ___
        ___ GRN CYN CYN CYN ___                                     ___ BLU BLU BLU ___ ___
        ___ MAJ ___ PUR PUR ___     YLW ORN GRN     ___ ___ ___     ___ GRN ___ GRN ___ ___
        ___ ___ COR COR COR         WHT WHT WHT     ___ PNK YLW         ___ ___ ___ ___ ___
      >;
      layer-id = <LAYER_Mouse>;
      fade-delay = <5>;
    };
    #endif

    /* MouseSlow */
    #ifdef LAYER_MouseSlow
    MouseSlow {
      bindings = <
        ___ ___ ___ ___ ___                                             ___ ___ ___ ___ ___
        ___ ___ ___ ___ ___ ___                                     ___ ___ ___ ___ ___ ___
        ___ ___ COR COR COR ___                                     ___ COR COR COR ___ ___
        ___ COR COR COR COR ___                                     ___ COR COR COR ___ ___
        ___ ___ ___ ___ ___ ___     ___ ___ ___     ___ ___ ___     ___ ___ ___ ___ ___ ___
        ___ ___ ___ ___ ___         ___ ___ ___     ___ ___ ___         ___ ___ ___ ___ ___
      >;
      layer-id = <LAYER_MouseSlow>;
      fade-delay = <5>;
    };
    #endif

    /* MouseRegular */
    #ifdef LAYER_MouseRegular
    MouseRegular {
      bindings = <
        ___ ___ ___ ___ ___                                             ___ ___ ___ ___ ___
        ___ ___ ___ ___ ___ ___                                     ___ ___ ___ ___ ___ ___
        ___ ___ GOL GOL GOL ___                                     ___ GOL GOL GOL ___ ___
        ___ GOL GOL GOL GOL ___                                     ___ GOL GOL GOL ___ ___
        ___ ___ ___ ___ ___ ___     ___ ___ ___     ___ ___ ___     ___ ___ ___ ___ ___ ___
        ___ ___ ___ ___ ___         ___ ___ ___     ___ ___ ___         ___ ___ ___ ___ ___
      >;
      layer-id = <LAYER_MouseRegular>;
      fade-delay = <5>;
    };
    #endif

    /* MouseFast */
    #ifdef LAYER_MouseFast
    MouseFast {
      bindings = <
        ___ ___ ___ ___ ___                                             ___ ___ ___ ___ ___
        ___ ___ ___ ___ ___ ___                                     ___ ___ ___ ___ ___ ___
        ___ ___ GRN GRN GRN ___                                     ___ GRN GRN GRN ___ ___
        ___ GRN GRN GRN GRN ___                                     ___ GRN GRN GRN ___ ___
        ___ ___ ___ ___ ___ ___     ___ ___ ___     ___ ___ ___     ___ ___ ___ ___ ___ ___
        ___ ___ ___ ___ ___         ___ ___ ___     ___ ___ ___         ___ ___ ___ ___ ___
      >;
      layer-id = <LAYER_MouseFast>;
      fade-delay = <5>;
    };
    #endif

    /* Lower */
    #ifdef LAYER_Lower
    Lower {
      bindings = <
        PNK PNK BLU BLU BLU                                             BLU BLU BLU ___ ORN
        ___ ___ ___ ___ ___ GRN                                     WHT ORN WHT WHT WHT ORN
        ___ ___ ___ GRN ___ GRN                                     WHT WHT WHT WHT WHT ORN
        ___ ___ GRN GRN GRN GRN                                     WHT WHT WHT WHT WHT ___
        ___ ORN ___ WHT WHT GRN     ___ ___ GRN     ___ ___ ___     WHT WHT WHT WHT WHT ___
        ___ ORN ORN WHT WHT         ___ ___ ___     ___ ___ ___         WHT WHT WHT WHT ___
      >;
      layer-id = <LAYER_Lower>;
      fade-delay = <15>;
    };
    #endif

  };
};

#undef RED
#undef RED_RGB
#undef ORN
#undef ORN_RGB
#undef YLW
#undef YLW_RGB
#undef GRN
#undef GRN_RGB
#undef CYN
#undef CYN_RGB
#undef AZU
#undef AZU_RGB
#undef BLU
#undef BLU_RGB
#undef PUR
#undef PUR_RGB
#undef MAJ
#undef MAJ_RGB
#undef PNK
#undef PNK_RGB
#undef WHT
#undef WHT_RGB
#undef ___
#undef BLK_RGB
#undef COR
#undef COR_RGB
#undef GOL
#undef GOL_RGB
#undef BCL
#endif

/* Generated input processors */


/* Macros para caracteres acentuados (Windows Alt codes) */
/ {
    macros {
        macro_a_tilde: macro_a_tilde {
            compatible = "zmk,behavior-macro";
            #binding-cells = <0>;
            wait-ms = <40>;
            tap-ms = <40>;
            bindings
                = <&macro_press &kp RALT>
                , <&macro_tap &kp A>
                , <&macro_release &kp RALT>;
        };
        macro_e_tilde: macro_e_tilde {
            compatible = "zmk,behavior-macro";
            #binding-cells = <0>;
            wait-ms = <40>;
            tap-ms = <40>;
            bindings
                = <&macro_press &kp RALT>
                , <&macro_tap &kp E>
                , <&macro_release &kp RALT>;
        };
        macro_i_tilde: macro_i_tilde {
            compatible = "zmk,behavior-macro";
            #binding-cells = <0>;
            wait-ms = <40>;
            tap-ms = <40>;
            bindings
                = <&macro_press &kp RALT>
                , <&macro_tap &kp I>
                , <&macro_release &kp RALT>;
        };
        macro_o_tilde: macro_o_tilde {
            compatible = "zmk,behavior-macro";
            #binding-cells = <0>;
            wait-ms = <40>;
            tap-ms = <40>;
            bindings
                = <&macro_press &kp RALT>
                , <&macro_tap &kp O>
                , <&macro_release &kp RALT>;
        };
        macro_u_tilde: macro_u_tilde {
            compatible = "zmk,behavior-macro";
            #binding-cells = <0>;
            wait-ms = <40>;
            tap-ms = <40>;
            bindings
                = <&macro_press &kp RALT>
                , <&macro_tap &kp U>
                , <&macro_release &kp RALT>;
        };
        macro_enye: macro_enye {
            compatible = "zmk,behavior-macro";
            #binding-cells = <0>;
            wait-ms = <40>;
            tap-ms = <40>;
            bindings
                = <&macro_press &kp RALT>
                , <&macro_tap &kp N>
                , <&macro_release &kp RALT>;
        };
        macro_win_space: macro_win_space {
            compatible = "zmk,behavior-macro";
            #binding-cells = <0>;
            wait-ms = <40>;
            tap-ms = <40>;
            bindings
                = <&macro_press &kp LGUI>
                , <&macro_tap &kp SPACE>
                , <&macro_release &kp LGUI>;
        };
        macro_ctrl_c: macro_ctrl_c {
            compatible = "zmk,behavior-macro";
            #binding-cells = <0>;
            wait-ms = <40>;
            tap-ms = <40>;
            bindings
                = <&macro_press &kp LCTRL>
                , <&macro_tap &kp C>
                , <&macro_release &kp LCTRL>;
        };
        macro_alt_tab: macro_alt_tab {
            compatible = "zmk,behavior-macro";
            #binding-cells = <0>;
            wait-ms = <40>;
            tap-ms = <40>;
            bindings
                = <&macro_press &kp LALT>
                , <&macro_tap &kp TAB>
                , <&macro_release &kp LALT>;
        };
        macro_ctrl_shift: macro_ctrl_shift {
            compatible = "zmk,behavior-macro";
            #binding-cells = <0>;
            bindings
                = <&macro_press &kp LSHFT &kp LCTRL>
                , <&macro_pause_for_release>
                , <&macro_release &kp LSHFT &kp LCTRL>;
        };
        macro_ctrl_z: macro_ctrl_z {
            compatible = "zmk,behavior-macro";
            #binding-cells = <0>;
            wait-ms = <40>;
            tap-ms = <40>;
            bindings
                = <&macro_press &kp LCTRL>
                , <&macro_tap &kp Z>
                , <&macro_release &kp LCTRL>;
        };
        macro_ctrl_y: macro_ctrl_y {
            compatible = "zmk,behavior-macro";
            #binding-cells = <0>;
            wait-ms = <40>;
            tap-ms = <40>;
            bindings
                = <&macro_press &kp LCTRL>
                , <&macro_tap &kp Y>
                , <&macro_release &kp LCTRL>;
        };
        macro_ctrl_x: macro_ctrl_x {
            compatible = "zmk,behavior-macro";
            #binding-cells = <0>;
            wait-ms = <40>;
            tap-ms = <40>;
            bindings
                = <&macro_press &kp LCTRL>
                , <&macro_tap &kp X>
                , <&macro_release &kp LCTRL>;
        };
        macro_ctrl_s: macro_ctrl_s {
            compatible = "zmk,behavior-macro";
            #binding-cells = <0>;
            wait-ms = <40>;
            tap-ms = <40>;
            bindings
                = <&macro_press &kp LCTRL>
                , <&macro_tap &kp S>
                , <&macro_release &kp LCTRL>;
        };
        macro_ctrl_f: macro_ctrl_f {
            compatible = "zmk,behavior-macro";
            #binding-cells = <0>;
            wait-ms = <40>;
            tap-ms = <40>;
            bindings
                = <&macro_press &kp LCTRL>
                , <&macro_tap &kp F>
                , <&macro_release &kp LCTRL>;
        };
        macro_ctrl_g: macro_ctrl_g {
            compatible = "zmk,behavior-macro";
            #binding-cells = <0>;
            wait-ms = <40>;
            tap-ms = <40>;
            bindings
                = <&macro_press &kp LCTRL>
                , <&macro_tap &kp G>
                , <&macro_release &kp LCTRL>;
        };
        macro_ctrl_v: macro_ctrl_v {
            compatible = "zmk,behavior-macro";
            #binding-cells = <0>;
            wait-ms = <40>;
            tap-ms = <40>;
            bindings
                = <&macro_press &kp LCTRL>
                , <&macro_tap &kp V>
                , <&macro_release &kp LCTRL>;
        };
    };
};

/* Hold-tap behaviors: tap = letra, hold = acento/ñ */
/ {
    behaviors {
        ht_a: ht_a {
            compatible = "zmk,behavior-hold-tap";
            #binding-cells = <2>;
            flavor = "tap-preferred";
            tapping-term-ms = <200>;
            require-prior-idle-ms = <150>;
            bindings = <&macro_a_tilde>, <&kp>;
        };
        ht_e: ht_e {
            compatible = "zmk,behavior-hold-tap";
            #binding-cells = <2>;
            flavor = "tap-preferred";
            tapping-term-ms = <200>;
            require-prior-idle-ms = <150>;
            bindings = <&macro_e_tilde>, <&kp>;
        };
        ht_i: ht_i {
            compatible = "zmk,behavior-hold-tap";
            #binding-cells = <2>;
            flavor = "tap-preferred";
            tapping-term-ms = <200>;
            require-prior-idle-ms = <150>;
            bindings = <&macro_i_tilde>, <&kp>;
        };
        ht_o: ht_o {
            compatible = "zmk,behavior-hold-tap";
            #binding-cells = <2>;
            flavor = "tap-preferred";
            tapping-term-ms = <200>;
            require-prior-idle-ms = <150>;
            bindings = <&macro_o_tilde>, <&kp>;
        };
        ht_u: ht_u {
            compatible = "zmk,behavior-hold-tap";
            #binding-cells = <2>;
            flavor = "tap-preferred";
            tapping-term-ms = <200>;
            require-prior-idle-ms = <150>;
            bindings = <&macro_u_tilde>, <&kp>;
        };
        ht_n: ht_n {
            compatible = "zmk,behavior-hold-tap";
            #binding-cells = <2>;
            flavor = "tap-preferred";
            tapping-term-ms = <200>;
            require-prior-idle-ms = <150>;
            bindings = <&macro_enye>, <&kp>;
        };
        ht_l: ht_l {
            compatible = "zmk,behavior-hold-tap";
            #binding-cells = <2>;
            flavor = "tap-preferred";
            tapping-term-ms = <200>;
            require-prior-idle-ms = <150>;
            bindings = <&macro_win_space>, <&kp>;
        };
        ht_s: ht_s {
            compatible = "zmk,behavior-hold-tap";
            #binding-cells = <2>;
            flavor = "tap-preferred";
            tapping-term-ms = <200>;
            require-prior-idle-ms = <150>;
            bindings = <&macro_ctrl_s>, <&kp>;
        };
        ht_f: ht_f {
            compatible = "zmk,behavior-hold-tap";
            #binding-cells = <2>;
            flavor = "tap-preferred";
            tapping-term-ms = <200>;
            require-prior-idle-ms = <150>;
            bindings = <&macro_ctrl_f>, <&kp>;
        };
        ht_g: ht_g {
            compatible = "zmk,behavior-hold-tap";
            #binding-cells = <2>;
            flavor = "tap-preferred";
            tapping-term-ms = <200>;
            require-prior-idle-ms = <150>;
            bindings = <&macro_ctrl_g>, <&kp>;
        };
        ht_z: ht_z {
            compatible = "zmk,behavior-hold-tap";
            #binding-cells = <2>;
            flavor = "tap-preferred";
            tapping-term-ms = <200>;
            require-prior-idle-ms = <150>;
            bindings = <&macro_ctrl_z>, <&kp>;
        };
        ht_y: ht_y {
            compatible = "zmk,behavior-hold-tap";
            #binding-cells = <2>;
            flavor = "tap-preferred";
            tapping-term-ms = <200>;
            require-prior-idle-ms = <150>;
            bindings = <&macro_ctrl_y>, <&kp>;
        };
        ht_x: ht_x {
            compatible = "zmk,behavior-hold-tap";
            #binding-cells = <2>;
            flavor = "tap-preferred";
            tapping-term-ms = <200>;
            require-prior-idle-ms = <150>;
            bindings = <&macro_ctrl_x>, <&kp>;
        };
        ht_c: ht_c {
            compatible = "zmk,behavior-hold-tap";
            #binding-cells = <2>;
            flavor = "tap-preferred";
            tapping-term-ms = <200>;
            require-prior-idle-ms = <150>;
            bindings = <&macro_ctrl_c>, <&kp>;
        };
        ht_v: ht_v {
            compatible = "zmk,behavior-hold-tap";
            #binding-cells = <2>;
            flavor = "tap-preferred";
            tapping-term-ms = <200>;
            require-prior-idle-ms = <150>;
            bindings = <&macro_ctrl_v>, <&kp>;
        };
        ht_tab: ht_tab {
            compatible = "zmk,behavior-hold-tap";
            #binding-cells = <2>;
            flavor = "balanced";
            tapping-term-ms = <200>;
            bindings = <&macro_alt_tab>, <&kp>;
        };
        ht_del_prog: ht_del_prog {
            compatible = "zmk,behavior-hold-tap";
            #binding-cells = <2>;
            flavor = "balanced";
            tapping-term-ms = <130>;
            bindings = <&mo>, <&kp>;
        };
    };
};

/* Automatically generated combos definitions */


/* Automatically generated keymap */
/ {
    keymap {
        compatible = "zmk,keymap";


        layer_Base {
            bindings = <
               &kp F1    &kp F2   &kp F3    &kp F4     &kp F5                                                                                  &kp F6     &kp F7    &kp F8    &kp F9    &kp F10
            &kp EQUAL    &kp N1   &kp N2    &kp N3     &kp N4  &kp N5                                                                  &kp N6  &kp N7     &kp N8    &kp N9    &kp N0  &kp MINUS
              &ht_tab 0 TAB     &kp Q    &kp W  &ht_e 0 E      &kp R   &kp T                                                                   &ht_y 0 Y  &ht_u 0 U  &ht_i 0 I  &ht_o 0 O     &kp P   &kp BSLH
              &kp ESC  &ht_a 0 A  &ht_s 0 S     &kp D  &ht_f 0 F  &ht_g 0 G                                                                   &kp H   &kp J      &kp K     &kp L  &kp SEMI    &kp SQT
            &kp GRAVE  &ht_z 0 Z  &ht_x 0 X  &ht_c 0 C  &ht_v 0 V   &kp B                &kp LSHFT              &kp LCTRL  &kp CAPS  &kp LGUI  &kp RCTRL  &kp RSHFT  &ht_n 0 N   &kp M  &kp COMMA   &kp DOT  &kp FSLH  &kp PG_UP
 &magic LAYER_Magic 0  &kp HOME  &kp END  &kp LEFT  &lt LAYER_Navigation RIGHT                    &kp BSPC  &ht_del_prog LAYER_Programming DEL  &kp LALT  &kp RALT    &kp RET  &kp SPACE          &kp UP   &kp DOWN  &kp LBKT  &kp RBKT  &kp PG_DN
            >;
        };

        layer_Lower {
            bindings = <
         &kp C_BRI_DN  &kp C_BRI_UP      &kp C_PREV      &kp C_NEXT         &kp C_PP                                                                         &kp C_MUTE  &kp C_VOL_DN  &kp C_VOL_UP            &none  &kp PAUSE_BREAK
               &trans         &none           &none           &none            &none   &kp HOME                                                  &kp LS(N9)  &kp KP_NUM  &kp KP_EQUAL  &kp KP_SLASH  &kp KP_MULTIPLY  &kp PRINTSCREEN
               &trans         &none           &none    &kp UP_ARROW            &none    &kp END                                                  &kp LS(N0)   &kp KP_N7     &kp KP_N8     &kp KP_N9     &kp KP_MINUS   &kp SCROLLLOCK
               &trans         &none  &kp LEFT_ARROW  &kp DOWN_ARROW  &kp RIGHT_ARROW  &kp PG_UP                                                  &kp LS(N5)   &kp KP_N4     &kp KP_N5     &kp KP_N6      &kp KP_PLUS            &none
               &trans     &kp K_APP           &none         &kp F11          &kp F12  &kp PG_DN  &trans  &trans   &to 0  &trans  &trans  &trans   &kp COMMA   &kp KP_N1     &kp KP_N2     &kp KP_N3     &kp KP_ENTER           &trans
 &magic LAYER_Magic 0      &kp CAPS         &kp INS         &kp F11          &kp F12             &trans  &trans  &trans  &trans  &trans  &trans               &kp KP_N0     &kp KP_N0    &kp KP_DOT     &kp KP_ENTER           &trans
            >;
        };

        layer_Magic {
            bindings = <
  &bt BT_CLR            &none            &none            &none             &none                                                                                  &none   &none   &none   &none  &bt BT_CLR_ALL
       &none            &none            &to 0  &to LAYER_Lower            &none            &none                                                         &none   &none   &none   &none   &none           &none
       &none  &rgb_ug RGB_SPI  &rgb_ug RGB_SAI  &rgb_ug RGB_HUI  &rgb_ug RGB_BRI  &rgb_ug RGB_TOG                                                         &none   &none   &none   &none   &none              &none
 &bootloader  &rgb_ug RGB_SPD  &rgb_ug RGB_SAD  &rgb_ug RGB_HUD  &rgb_ug RGB_BRD  &rgb_ug RGB_EFF                                                         &none   &none   &none   &none   &none        &bootloader
   &sys_reset            &none            &none            &none            &none            &none   &bt_2   &bt_3  &to LAYER_Numbers   &none   &none   &none   &none   &none   &none   &none   &none         &sys_reset
       &none            &none            &none            &none            &none                    &bt_0   &bt_1  &out OUT_USB   &none   &none  &to LAYER_Mouse           &none   &none   &none   &none  &to LAYER_Factory
            >;
        };

        layer_Programming {
            bindings = <
      &none      &none       &none       &none         &none                                                                                                            &none         &none         &none         &none   &none
      &none      &none       &none       &none         &none   &none                                                                                     &none          &none         &none         &none         &none   &none
      &none      &none   &kp GRAVE       &none    &kp LS(N4)   &none                                                                                &kp LS(N6)     &kp LS(N9)    &kp LS(N0)     &kp MINUS         &none   &none
      &none  &kp LSHFT  &kp LS(N2)  &kp LS(N3)    &kp LS(N5)   &none                                                                                &kp LS(N7)   &kp LS(LBKT)  &kp LS(RBKT)     &kp EQUAL       &kp SQT   &none
 &kp C_PREV     &trans       &none       &none  &kp LS(FSLH)   &none  &kp LSHFT  &kp LCTRL     &to 0  &kp LGUI  &kp RCTRL          &kp RSHFT      &kp LS(N8)       &kp LBKT      &kp RBKT    &kp LS(N1)      &kp BSLH   &none
 &kp C_NEXT   &kp C_PP       &none       &none         &none            &kp BSPC  &mo LAYER_Numbers  &kp LALT  &kp RALT    &kp RET  &kp SPACE                 &kp LS(COMMA)   &kp LS(DOT)  &kp LS(SEMI)         &none   &none
            >;
        };

        layer_Numbers {
            bindings = <
 &trans     &trans      &trans     &trans     &trans                                                                          &trans      &trans      &trans      &trans       &trans
 &trans     &trans   &kp F10   &kp F11   &kp F12  &trans                                                          &trans  &trans  &kp FSLH  &kp LS(N8)  &kp MINUS       &trans
 &trans     &trans    &kp F7    &kp F8    &kp F9  &trans                                                          &trans  &kp N7     &kp N8      &kp N9  &kp LS(EQUAL)  &trans
 &kp LSHFT  &kp LALT  &kp F4    &kp F5    &kp F6  &trans                                                          &trans  &kp N4     &kp N5      &kp N6  &kp LS(EQUAL)  &trans
 &kp LGUI  &kp LCTRL  &kp F1    &kp F2    &kp F3  &trans  &trans  &trans  &to 0  &trans  &trans  &trans        &trans  &kp N1     &kp N2      &kp N3  &trans         &trans
 &trans     &trans     &trans  &trans  &trans          &trans  &trans  &trans  &trans  &trans  &trans        &kp N0  &kp DOT    &trans      &trans  &trans
            >;
        };

        layer_Navigation {
            bindings = <
 &trans  &trans  &trans  &trans  &trans                                                                  &trans      &trans    &trans     &trans  &trans
 &trans  &trans  &trans  &trans  &trans  &trans                                                  &trans  &trans      &trans    &trans     &trans  &trans
 &trans  &trans  &kp C_PREV  &kp C_PP  &kp C_NEXT  &trans                                                  &trans  &kp LA(LEFT)    &kp UP    &kp LA(RIGHT)    &trans  &trans
 &trans  &trans  &kp C_VOL_DN  &kp C_MUTE  &kp C_VOL_UP  &trans                                                  &trans  &kp LEFT  &kp DOWN  &kp RIGHT    &trans  &trans
 &trans  &trans  &trans  &trans  &trans  &trans  &macro_ctrl_shift  &trans  &trans  &trans  &trans  &trans  &trans    &kp HOME    &trans     &kp END     &trans  &trans
 &trans  &trans  &trans  &trans  &trans          &trans  &trans  &trans  &trans  &trans  &trans            &trans    &trans     &trans     &trans  &trans
            >;
        };

        layer_Mouse {
            bindings = <
 &none          &none          &none             &none            &none                                                                                     &none          &none           &none          &none      &none
 &none          &none          &none             &none            &none      &none                                                               &none      &none          &none           &none          &none      &none
 &kp TAB        &none      &mkp LCLK      &msc SCRL_UP      &mkp RCLK  &none                                                               &none   &kp LA(LEFT)   &mmv MOVE_UP   &kp LA(RIGHT)      &none      &none
 &none      &kp LCTRL   &msc SCRL_LEFT  &msc SCRL_DOWN  &msc SCRL_RIGHT  &none                                                               &none  &mmv MOVE_LEFT  &mmv MOVE_DOWN  &mmv MOVE_RIGHT    &none      &none
 &none      &kp LSHFT          &none      &macro_ctrl_c    &macro_ctrl_v      &none  &mkp LCLK  &mkp RCLK  &to 0  &none      &none      &none              &none   &kp HOME          &none        &kp END          &none      &none
 &none          &none  &mo LAYER_MouseSlow  &mo LAYER_MouseRegular  &mo LAYER_MouseFast    &kp BSPC     &kp DEL  &kp LALT  &none  &mkp MCLK  &mkp LCLK                 &none          &none           &none          &none      &none
            >;
        };

        layer_MouseSlow {
            bindings = <
 &none  &none  &none  &none  &none                                                                  &none  &none  &none  &none  &none
 &none  &none  &none  &none  &none  &none                                                  &none  &none  &none  &none  &none  &none
 &none  &none  &none  &none  &none  &none                                                  &none  &none  &none  &none  &none  &none
 &none  &none  &none  &none  &none  &none                                                  &none  &none  &none  &none  &none  &none
 &none  &none  &none  &none  &none  &none  &none  &none  &none  &none  &none  &none  &none  &none  &none  &none  &none  &none
 &none  &none  &none  &none  &none          &none  &none  &none  &none  &none  &none          &none  &none  &none  &none  &none
            >;
        };

        layer_MouseRegular {
            bindings = <
 &none  &none  &none  &none  &none                                                                  &none  &none  &none  &none  &none
 &none  &none  &none  &none  &none  &none                                                  &none  &none  &none  &none  &none  &none
 &none  &none  &none  &none  &none  &none                                                  &none  &none  &none  &none  &none  &none
 &none  &none  &none  &none  &none  &none                                                  &none  &none  &none  &none  &none  &none
 &none  &none  &none  &none  &none  &none  &none  &none  &none  &none  &none  &none  &none  &none  &none  &none  &none  &none
 &none  &none  &none  &none  &none          &none  &none  &none  &none  &none  &none          &none  &none  &none  &none  &none
            >;
        };

        layer_MouseFast {
            bindings = <
 &none  &none  &none  &none  &none                                                                  &none  &none  &none  &none  &none
 &none  &none  &none  &none  &none  &none                                                  &none  &none  &none  &none  &none  &none
 &none  &none  &none  &none  &none  &none                                                  &none  &none  &none  &none  &none  &none
 &none  &none  &none  &none  &none  &none                                                  &none  &none  &none  &none  &none  &none
 &none  &none  &none  &none  &none  &none  &none  &none  &none  &none  &none  &none  &none  &none  &none  &none  &none  &none
 &none  &none  &none  &none  &none          &none  &none  &none  &none  &none  &none          &none  &none  &none  &none  &none
            >;
        };

        layer_Factory {
            bindings = <
 &kp NUMBER_0  &kp NUMBER_6  &kp NUMBER_2  &kp NUMBER_8  &kp NUMBER_4                                                                                                                  &kp NUMBER_4  &kp NUMBER_8  &kp NUMBER_2  &kp NUMBER_6  &kp NUMBER_0
 &kp NUMBER_1  &kp NUMBER_7  &kp NUMBER_3  &kp NUMBER_9  &kp NUMBER_5  &kp NUMBER_0                                                                                      &kp NUMBER_0  &kp NUMBER_5  &kp NUMBER_9  &kp NUMBER_3  &kp NUMBER_7  &kp NUMBER_1
 &kp NUMBER_2  &kp NUMBER_8  &kp NUMBER_4  &kp NUMBER_0  &kp NUMBER_6  &kp NUMBER_1                                                                                      &kp NUMBER_1  &kp NUMBER_6  &kp NUMBER_0  &kp NUMBER_4  &kp NUMBER_8  &kp NUMBER_2
 &kp NUMBER_3  &kp NUMBER_9  &kp NUMBER_5  &kp NUMBER_1  &kp NUMBER_7  &kp NUMBER_2                                                                                      &kp NUMBER_2  &kp NUMBER_7  &kp NUMBER_1  &kp NUMBER_5  &kp NUMBER_9  &kp NUMBER_3
 &kp NUMBER_4  &kp NUMBER_0  &kp NUMBER_6  &kp NUMBER_2  &kp NUMBER_8  &kp NUMBER_3  &kp NUMBER_4  &kp NUMBER_5  &kp NUMBER_6  &kp NUMBER_6  &kp NUMBER_5  &kp NUMBER_4  &kp NUMBER_3  &kp NUMBER_8  &kp NUMBER_2  &kp NUMBER_6  &kp NUMBER_0  &kp NUMBER_4
 &kp NUMBER_5  &kp NUMBER_1  &kp NUMBER_7  &kp NUMBER_3  &kp NUMBER_9                &kp NUMBER_7  &kp NUMBER_8  &kp NUMBER_9  &kp NUMBER_9  &kp NUMBER_8  &kp NUMBER_7                &kp NUMBER_9  &kp NUMBER_3  &kp NUMBER_7  &kp NUMBER_1  &kp NUMBER_5
            >;
        };

    };
};
